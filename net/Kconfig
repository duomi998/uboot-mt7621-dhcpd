## net/Kconfig
```kconfig
#
# Network configuration
#

menuconfig NET
	bool "Networking support"
	default y

if NET

config NET_RANDOM_ETHADDR
	bool "Random ethaddr if unset"
	help
	  Selecting this will allow the Ethernet interface to function
	  even when the ethaddr variable for that interface is unset.
	  A new MAC address will be generated on every boot and it will
	  not be added to the environment.

config NETCONSOLE
	bool "NetConsole support"
	help
	  Support the 'nc' input/output device for networked console.
	  See README.NetConsole for details.

config TCP
	bool
	default n

config HTTPD
	bool
	default n
	depends on TCP

config MTK_DHCPD
	bool "Minimal DHCP server for MediaTek web failsafe"
	default y
	depends on HTTPD
	help
	  Enable a minimal DHCPv4 server that answers DHCPDISCOVER/DHCPREQUEST
	  while the MediaTek web failsafe UI (httpd) is running.

config MTK_DHCPD_USE_CONFIG_IP
	bool "Use CONFIG_IPADDR/CONFIG_NETMASK and configurable pool"
	default n
	depends on MTK_DHCPD
	help
	  Use CONFIG_IPADDR and CONFIG_NETMASK as DHCP server address/netmask.
	  Pool start host and size are taken from the options below.
	  If disabled, fallback defaults will be used.
	  Warning: DO NOT enable this if in U-Boot Version < 2023.07, 
	  as it may cause boot failures due to DHCP server misconfiguration.

config MTK_DHCPD_POOL_START_HOST
	int "DHCP pool start host address"
	default 100
	depends on MTK_DHCPD_USE_CONFIG_IP
	help
	  Host part for pool start. For example, 100 -> x.x.x.100.

config MTK_DHCPD_POOL_SIZE
	int "DHCP pool size"
	default 101
	depends on MTK_DHCPD_USE_CONFIG_IP
	help
	  Pool size, e.g. 101 means .100 ~ .200.

config MTK_DHCPD_ENHANCED
	bool "Enhanced DHCP server behavior"
	default y
	depends on MTK_DHCPD
	help
	  Enable enhanced DHCPREQUEST validation and stable IP allocation.
	  Adds Server Identifier checks, DHCPNAK support, and hash-based pool
	  allocation with collision avoidance.

endif   # if NET
```
